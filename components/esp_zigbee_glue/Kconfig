## components/esp_zigbee_glue/Kconfig
```kconfig
# SPDX-FileCopyrightText: 2025-2026 Evgenij Cjura and project contributors
# SPDX-License-Identifier: AGPL-3.0-or-later
#
# Zigbee radio backend selection (design doc §4). Peer to the existing znp /
# ezsp backends. DEFAULT = ZNP so every current firmware's behaviour is
# unchanged; ESP_ZIGBEE is opt-in and gates the esp-zigbee-lib dependency
# (idf_component.yml) + all glue code (#if CONFIG_ZHAC_ZIGBEE_BACKEND_ESP_ZIGBEE).
#
# Placed in a component so the symbols are visible project-wide; the choice is
# also readable by the component manager's $CONFIG{...} conditional-dep rules.

menu "ZHAC Zigbee backend"

choice ZHAC_ZIGBEE_BACKEND
    prompt "Zigbee radio backend"
    default ZHAC_ZIGBEE_BACKEND_ZNP
    help
        Which radio backend registers with zhc_adapter / device_backend.
        All three feed the same device library, shadow, rules and gateway.

    config ZHAC_ZIGBEE_BACKEND_ZNP
        bool "TI Z-Stack (CC2652/CC2530) over MT/UART — znp_driver"

    config ZHAC_ZIGBEE_BACKEND_EZSP
        bool "Silabs EFR32 over EZSP/UART"

    config ZHAC_ZIGBEE_BACKEND_ESP_ZIGBEE
        bool "esp-zigbee-lib (RCP: external ESP32-H2/C6 running ot_rcp)"
        help
            Native esp-zigbee-lib stack on the host, driving an external
            802.15.4 radio (ESP32-H2/C6 with stock ot_rcp) over Spinel/UART.
            The ESP32-P4 has no radio, so on the flagship this is RCP-only.
            Pulls in espressif/esp-zigbee-lib.

endchoice

endmenu
```

## components/metrics/Kconfig
```kconfig
# SPDX-FileCopyrightText: 2025-2026 Evgenij Cjura and project contributors
# SPDX-License-Identifier: Apache-2.0
menu "Metrics engine"

config METRICS_ENABLED
    bool "Enable metrics engine"
    default y
    help
        Master switch. When n, all _METRIC_* macros compile to no-ops
        and the metrics namespace provides empty stub implementations.

config METRICS_NUM_SHARDS
    int "Per-core shard count"
    depends on METRICS_ENABLED
    default 2
    range 1 4
    help
        One atomic shard per slot avoids cross-core contention. Default
        covers both P4 and S3 (both are 2-core). Keep small; exporters
        aggregate shards on read.

config METRICS_ENABLE_MEMORY_METRICS
    bool "Record heap snapshot metrics"
    depends on METRICS_ENABLED
    default y

config METRICS_ENABLE_TEXT_DUMP
    bool "Enable human-readable metrics dump"
    depends on METRICS_ENABLED
    default y

config METRICS_ENABLE_PROMETHEUS_EXPORTER
    bool "Enable Prometheus text exporter"
    depends on METRICS_ENABLED
    default y
    help
        Pure formatter — bounded-buffer writer, no heap, no transport.
        Needed on P4 too since the S3 pulls P4's Prometheus blob via
        METRICS_REQ / METRICS_RSP for cross-chip /metrics merge.

config METRICS_ENABLE_MQTT_EXPORTER
    bool "Enable MQTT JSON exporter"
    depends on METRICS_ENABLED
    default y if IDF_TARGET_ESP32S3
    default n

config METRICS_EXPORT_PREFIX
    string "Prometheus metric name prefix"
    depends on METRICS_ENABLED
    default "zhac"

config METRICS_MQTT_INTERVAL_S
    int "MQTT snapshot publish interval (seconds)"
    depends on METRICS_ENABLED && METRICS_ENABLE_MQTT_EXPORTER
    default 60
    range 10 3600

endmenu
```

## components/mqtt_gw/Kconfig
```kconfig
# SPDX-FileCopyrightText: 2025-2026 Evgenij Cjura and project contributors
# SPDX-License-Identifier: AGPL-3.0-or-later
menu "MQTT Gateway"

config MQTT_BROKER_URL
    string "MQTT broker URL"
    default ""
    help
        URI of the MQTT broker (e.g. mqtt://192.168.1.100:1883).
        F-09: default left empty so a fresh checkout does not silently
        connect to whatever URL the original developer baked into a
        local sdkconfig. Set per-deployment via menuconfig or the
        runtime API. Empty value → MQTT client is not started.

endmenu
```

## components/zigbee_mgr/Kconfig
```kconfig
# zigbee_mgr component options.

menu "ZHAC zigbee_mgr"

config ZHAC_SPIKE_COORD_GROUP_JOIN
    bool "SPIKE: coordinator joins an APS group (native-groups Part B experiment)"
    default n
    help
      EXPERIMENTAL — leave OFF for production. Tests whether this radio's ZNP
      will let the coordinator RECEIVE groupcast frames that a hardware
      zone-remote (MiBoxer FUT089Z, groups 101-108) sends, so the remote's
      button presses reach the ZHAC rule engine.

      When enabled it (1) advertises the ZCL Groups (0x0004) cluster as an INPUT
      cluster on coordinator endpoint 1 (so the ZNP may instantiate a Groups
      server there), and (2) after init, loopback-sends a ZCL Add-Group command
      to the coordinator's own short address (0x0000) endpoint 1, attempting to
      join CONFIG_ZHAC_SPIKE_COORD_GROUP_ID.

      On a stock TI ZNP the ZCL layer runs on the host, so the loopback may only
      be delivered back as an AF_INCOMING frame rather than joining the group —
      that negative result is exactly what the spike measures. See
      extra/docs/NATIVE_ZCL_GROUPS_DESIGN.md (Part B).

config ZHAC_SPIKE_COORD_GROUP_ID
    int "SPIKE: group id the coordinator tries to join"
    depends on ZHAC_SPIKE_COORD_GROUP_JOIN
    default 101
    range 1 65535
    help
      MiBoxer FUT089Z maps zone 1 to group 101 by default. Set this to the group
      id of the zone button you will press during the test.

endmenu
```
