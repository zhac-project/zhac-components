## components/zhc_adapter/Kconfig
```kconfig
# SPDX-FileCopyrightText: 2025-2026 Evgenij Cjura and project contributors
# SPDX-License-Identifier: AGPL-3.0-or-later
menu "ZHAC zhc_adapter"

config ZHAC_METER_POLL_S
    int "Meter poll interval (s), 0 = off"
    default 60
    range 0 86400
    help
      Devices whose definition sets meter_poll (e.g. Tuya TS011F plugs that
      never report power/energy) get their electrical measurement and/or
      metering read every this many seconds, like zigbee2mqtt's
      measurement_poll_interval (default 60). Mains-powered devices only.
      0 turns polling off.

config ZHAC_PING_S
    int "Ping quiet mains devices after (s), 0 = off"
    default 600
    range 0 86400
    help
      A device that keeps its receiver on (a router not on battery, or a
      mains-powered one) the hub has not heard from for this many seconds
      gets a ping, a read of Basic zclVersion, like zigbee2mqtt's
      availability (active timeout, default 10 min). A device that answers
      keeps a fresh last_seen even when it never reports, e.g. a light driven
      only by its own remote. Unanswered pings back off as z2m's do: 1.5x,
      then twice as long each time, up to a day. Such a device is offline
      once it has sent nothing for an hour with its ping unanswered; a device
      that is not pinged (battery) once it has sent nothing for 48 hours.
      0 turns pings and the hub's offline verdicts off (Home Assistant still
      marks a battery device unavailable after 48 hours of silence).

endmenu
```
